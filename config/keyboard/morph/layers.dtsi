// tap:   escape      
// hold:  to BAS layer
// shift: caps lock
mp_key_bas: morph_key_bas_layer {
    compatible = "zmk,behavior-mod-morph";
    #binding-cells = <0>;
    mods = <(MOD_LSFT|MOD_RSFT)>;
    bindings = <&to_BAS_kp 0 ESC>, <&m_caps_word_CAPS>;
};

// mp_BAS_al
MORPH_KS(
    BAS,
    al,
    axn_left,
    &mo_AXN_to_BAS_kp 0 TAB,    // tap: tab ¦ hold: to AXN momentary
    &kp LS(TAB)                 // shift: reverse tab
)

// mp_BAS_ar
MORPH_KS(
    BAS,
    ar,
    axn_right,
    &mo_AXN_to_BAS_kp 0 BSPC,   // tap: backspace ¦ hold: to AXN momentary
    &kp DEL                     // shift: delete
)

//mp_BAS_sr
MORPH_KS(
    BAS,
    sr,
    stg_right,
    &mo_STG_to_BAS,             // hold: to FNK momentary
    &to_STG                     // shift: to STG layer
)
