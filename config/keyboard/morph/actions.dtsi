// tap:     ⇺
// shift:   ⎗
mp_action_prev: morph_action_prev {
    compatible = "zmk,behavior-mod-morph";
    #binding-cells = <0>;
    mods = <(MOD_LSFT|MOD_RSFT)>;
    bindings = <&kp RC(PG_UP)>, <&kp LC(LG(LEFT))>;
};

// tap:     ⇻
// shift:   ⎘
mp_action_next: morph_action_next {
    compatible = "zmk,behavior-mod-morph";
    #binding-cells = <0>;
    mods = <(MOD_LSFT|MOD_RSFT)>;
    bindings = <&kp RC(PG_DN)>, <&kp LC(LG(RIGHT))>;
};

// tap:     paste
// shift:   paste without format
mp_action_paste: morph_action_paste {
    compatible = "zmk,behavior-mod-morph";
    #binding-cells = <0>;
    mods = <(MOD_LSFT|MOD_RSFT)>;
    bindings = <&kp RG(V)>, <&kp RS(RG(V))>;
};

// tap:     -
// shift:   _
mp_key_m: morph_key_minus {
    compatible = "zmk,behavior-mod-morph";
    #binding-cells = <0>;
    mods = <(MOD_LSFT|MOD_RSFT)>;
    bindings = <&kp MINUS>, <&kp UNDER>;
};

// mp_DEV_ar
MORPH_KS(
    DEV,
    ar,
    axn_right,
    &kp BSPC,   // tap: backspace
    &kp DEL     // shift: delete
)
