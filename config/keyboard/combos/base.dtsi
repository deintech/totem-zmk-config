/*
 * Copyright (c) 2025 Camilo Martinez (Equiman)
 * SPDX-License-Identifier: MIT
 *
 * Documentation:
 * @see https://zmk.dev/docs/keymaps/combos
 */

combo_CW_on {
    bindings = <&m_caps_word_ON>;
    key-positions = <13 16>;
    slow-release;
    layers = <BAS>;
};

combo_CW_off {
    bindings = <&m_caps_word_OFF>;
    key-positions = <11 18>;
    slow-release;
    layers = <BAS>;
};
