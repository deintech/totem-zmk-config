combo_to_FNK {
    bindings = <&to_FNK>;
    key-positions = <4 5>;
    slow-release;
    layers = <BAS DEV AXN FNK STG>;
};

combo_to_AXN {
    bindings = <&to_AXN>;
    key-positions = <14 15>;
    slow-release;
    llayers = <BAS DEV AXN FNK STG>;
};

combo_to_DEV {
    bindings = <&to_DEV>;
    key-positions = <25 26>;
    slow-release;
    layers = <BAS DEV AXN FNK STG>;
};

combo_to_STG {
    bindings = <&mo_STG_to_BAS>;
    key-positions = <34 35>;
    slow-release;
    layers = <BAS DEV AXN FNK STG>;
};