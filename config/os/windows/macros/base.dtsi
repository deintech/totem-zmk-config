cw_wCAPS: cw_wCAPS {
    compatible = "zmk,behavior-macro";
    #binding-cells = <0>;
    tap-ms = <MC_TAP>;
    bindings
        = <&kp LS(H_wCWR)>
        , <&kp CAPS>;
};

cw_wON: cw_wON {
    compatible = "zmk,behavior-macro";
    #binding-cells = <0>;
    bindings
        = <&kp LA(H_wCWR)>
        , <&cw>;
};

cw_wOFF: cw_wOFF {
    compatible = "zmk,behavior-macro";
    #binding-cells = <0>;
    bindings
        = <&kp LS(LC(H_wCWR))>
        , <&kp K_CANCEL>;
};
