to_wBAS_kp: to_wBAS_kp {
    compatible = "zmk,behavior-hold-tap";
    #binding-cells = <2>;
    tapping-term-ms = <HP_TAPPING>;
    flavor = "hold-preferred";
    bindings = <&to_wBAS>, <&kp>;
};

mo_wDEV_to_wBAS_kp: mo_wDEV_to_wBAS_kp {
    compatible = "zmk,behavior-hold-tap";
    #binding-cells = <2>;
    tapping-term-ms = <HP_TAPPING>;
    flavor = "hold-preferred";
    bindings = <&mo_wDEV_to_wBAS>, <&kp>;
};

mo_wAXN_to_wBAS_kp: mo_wAXN_to_wBAS_kp {
    compatible = "zmk,behavior-hold-tap";
    #binding-cells = <2>;
    tapping-term-ms = <HP_TAPPING>;
    flavor = "hold-preferred";
    bindings = <&mo_wAXN_to_wBAS>, <&kp>;
};

mo_wSTG_to_wBAS_kp: mo_wSTG_to_wBAS_kp {
    compatible = "zmk,behavior-hold-tap";
    #binding-cells = <2>;
    tapping-term-ms = <HP_TAPPING>;
    flavor = "hold-preferred";
    bindings = <&mo_wSTG_to_wBAS>, <&kp>;
};