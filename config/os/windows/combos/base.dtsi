combo_wCW_on {
    bindings = <&cw_wON>;
    key-positions = <13 16>;
    slow-release;
    layers = <wBAS>;
};

combo_wCW_off {
    bindings = <&cw_wOFF>;
    key-positions = <11 18>;
    slow-release;
    layers = <wBAS>;
};