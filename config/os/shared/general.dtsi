/*
 * Copyright (c) 2025 Camilo Martinez (Equiman)
 * SPDX-License-Identifier: MIT
 *
 * Documentation:
 * @see https://zmk.dev/docs/behaviors/hold-tap
 * @see https://zmk.dev/docs/behaviors/caps-word
 * @see https://zmk.dev/docs/features/tapping-terms
 * @see https://zmk.dev/docs/keymaps/key-codes
 */

/* Mod Tap */
&mt {
    tapping-term-ms = <MT_TAPPING>;
    quick-tap-ms = <MT_QUICK_TAP>;      // repeat on tap-into-hold
    flavor = "tap-preferred";
    hold-trigger-key-positions = <0>;   // tap on interrupt
};

/* Caps Word */
cw: caps_word {
    compatible = "zmk,behavior-caps-word";
    #binding-cells = <0>;
    continue-list = <UNDERSCORE MINUS BACKSPACE DEL>;
};
