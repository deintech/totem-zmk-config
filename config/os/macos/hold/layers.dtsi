to_BAS_kp: to_BAS_kp {
    compatible = "zmk,behavior-hold-tap";
    #binding-cells = <2>;
    tapping-term-ms = <HP_TAPPING>;
    flavor = "hold-preferred";
    bindings = <&to_mBAS>, <&kp>;
};

mo_DEV_to_BAS_kp: mo_DEV_to_BAS_kp {
    compatible = "zmk,behavior-hold-tap";
    #binding-cells = <2>;
    tapping-term-ms = <HP_TAPPING>;
    flavor = "hold-preferred";
    bindings = <&mo_mDEV_to_mBAS>, <&kp>;
};

mo_AXN_to_BAS_kp: mo_AXN_to_BAS_kp {
    compatible = "zmk,behavior-hold-tap";
    #binding-cells = <2>;
    tapping-term-ms = <HP_TAPPING>;
    flavor = "hold-preferred";
    bindings = <&mo_mAXN_to_mBAS>, <&kp>;
};

mo_STG_to_BAS_kp: mo_STG_to_BAS_kp {
    compatible = "zmk,behavior-hold-tap";
    #binding-cells = <2>;
    tapping-term-ms = <HP_TAPPING>;
    flavor = "hold-preferred";
    bindings = <&mo_mSTG_to_mBAS>, <&kp>;
};
