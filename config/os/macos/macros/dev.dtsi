// action:  ?░:░
m_operator_cto: macro_operator_conditional_ternary {
    compatible = "zmk,behavior-macro";
    #binding-cells = <0>;
    bindings
        = <&none>
        , <&macro_wait_time MC_WAIT>
        , <&kp QMARK &kp SPACE &kp SPACE &kp COLON &kp SPACE>
        , <&kp LEFT &kp LEFT &kp LEFT>;
};

// action:  ?.
m_operator_oco: macro_operator_optional_chaining {
    compatible = "zmk,behavior-macro";
    #binding-cells = <0>;
    bindings
        = <&kp QMARK &kp DOT>;
};
