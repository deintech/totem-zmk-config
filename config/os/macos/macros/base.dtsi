m_caps_word_CAPS: m_caps_word_CAPS {
    compatible = "zmk,behavior-macro";
    #binding-cells = <0>;
    tap-ms = <MC_TAP>;
    bindings
        = <&kp LS(FK_CWR)>
        , <&kp CAPS>;
};

m_caps_word_ON: m_caps_word_ON {
    compatible = "zmk,behavior-macro";
    #binding-cells = <0>;
    bindings
        = <&kp LA(FK_CWR)>
        , <&cw>;
};

m_caps_word_OFF: m_caps_word_OFF {
    compatible = "zmk,behavior-macro";
    #binding-cells = <0>;
    bindings
        = <&kp LS(LC(FK_CWR))>
        , <&kp K_CANCEL>;
};