// tap:     '
// shift:   "
mp_key_q: morph_key_quote {
    compatible = "zmk,behavior-mod-morph";
    #binding-cells = <0>;
    mods = <(MOD_LSFT|MOD_RSFT)>;
    bindings = <&m_locale_s>, <&m_locale_d>;
};
