combo_mCW_on {
    bindings = <&m_caps_word_ON>;
    key-positions = <13 16>;
    slow-release;
    layers = <mBAS>;
};

combo_mCW_off {
    bindings = <&m_caps_word_OFF>;
    key-positions = <11 18>;
    slow-release;
    layers = <mBAS>;
};