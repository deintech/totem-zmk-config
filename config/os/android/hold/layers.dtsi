to_aBAS_kp: to_aBAS_kp {
    compatible = "zmk,behavior-hold-tap";
    #binding-cells = <2>;
    tapping-term-ms = <HP_TAPPING>;
    flavor = "hold-preferred";
    bindings = <&to_aBAS>, <&kp>;
};

mo_aDEV_to_aBAS_kp: mo_aDEV_to_aBAS_kp {
    compatible = "zmk,behavior-hold-tap";
    #binding-cells = <2>;
    tapping-term-ms = <HP_TAPPING>;
    flavor = "hold-preferred";
    bindings = <&mo_aDEV_to_aBAS>, <&kp>;
};

mo_aAXN_to_aBAS_kp: mo_aAXN_to_aBAS_kp {
    compatible = "zmk,behavior-hold-tap";
    #binding-cells = <2>;
    tapping-term-ms = <HP_TAPPING>;
    flavor = "hold-preferred";
    bindings = <&mo_aAXN_to_aBAS>, <&kp>;
};

mo_aSTG_to_aBAS_kp: mo_aSTG_to_aBAS_kp {
    compatible = "zmk,behavior-hold-tap";
    #binding-cells = <2>;
    tapping-term-ms = <HP_TAPPING>;
    flavor = "hold-preferred";
    bindings = <&mo_aSTG_to_aBAS>, <&kp>;
};