cw_aCAPS: cw_aCAPS {
    compatible = "zmk,behavior-macro";
    #binding-cells = <0>;
    tap-ms = <MC_TAP>;
    bindings
        = <&kp LS(H_wCWR)>
        , <&kp CAPS>;
};

cw_aON: cw_aON {
    compatible = "zmk,behavior-macro";
    #binding-cells = <0>;
    bindings
        = <&kp LA(H_aCWR)>
        , <&cw>;
};

cw_aOFF: cw_aOFF {
    compatible = "zmk,behavior-macro";
    #binding-cells = <0>;
    bindings
        = <&kp LS(LC(H_aCWR))>
        , <&kp K_CANCEL>;
};