// action: ?░:░
m_ad_cto: macro_android_conditional_ternary_operator {
    compatible = "zmk,behavior-macro";
    #binding-cells = <0>;
    bindings
        = <&none>
        , <&macro_wait_time MC_WAIT>
        , <&kp QMARK &kp SPACE &kp SPACE &kp COLON &kp SPACE>
        , <&kp LEFT &kp LEFT &kp LEFT>;
};

// action: ?.
m_ad_oco: macro_android_optional_chaining_operator {
    compatible = "zmk,behavior-macro";
    #binding-cells = <0>;
    bindings
        = <&kp QMARK &kp DOT>;
};
